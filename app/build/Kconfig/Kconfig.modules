## app/build/Kconfig/Kconfig.modules
```kconfig
menu "ufsm292-zephyr-app-2026.git (C:/zephyr-workspace/ufsm292-zephyr-app-2026.git)"
osource "C:/zephyr-workspace/ufsm292-zephyr-app-2026.git/Kconfig"
config ZEPHYR_UFSM292_ZEPHYR_APP_2026_GIT_MODULE
	bool
	default y
endmenu
menu "cmsis_6 (C:/zephyr-workspace/modules/hal/cmsis_6)"
osource "$(ZEPHYR_CMSIS_6_KCONFIG)"
config ZEPHYR_CMSIS_6_MODULE
	bool
	default y
endmenu
config ZEPHYR_ATMEL_MODULE
	bool
	default y
menu "hal_nordic (C:/zephyr-workspace/modules/hal/nordic)"
osource "$(ZEPHYR_HAL_NORDIC_KCONFIG)"
config ZEPHYR_HAL_NORDIC_MODULE
	bool
	default y

config ZEPHYR_HAL_NORDIC_MODULE_BLOBS
	bool
endmenu
config ZEPHYR_HAL_STM32_MODULE
	bool
	default y

config ZEPHYR_HAL_STM32_MODULE_BLOBS
	bool
```

## app/build/Kconfig/Kconfig.shield.defconfig
```kconfig
osource "C:/zephyr-workspace/ufsm292-zephyr-app-2026.git/boards/shields/*/Kconfig.defconfig"
```

## app/build/Kconfig/Kconfig.sysbuild.modules
```kconfig
config ZEPHYR_UFSM292_ZEPHYR_APP_2026_GIT_MODULE
   bool
   default y
config ZEPHYR_CMSIS_6_MODULE
   bool
   default y
config ZEPHYR_ATMEL_MODULE
   bool
   default y
config ZEPHYR_HAL_NORDIC_MODULE
   bool
   default y
config ZEPHYR_HAL_STM32_MODULE
   bool
   default y
```

## app/build/Kconfig/arch/Kconfig
```kconfig
# Load Zephyr Arch Kconfig descriptions.
osource "C:/zephyr-workspace/zephyr/arch/tricore/Kconfig"
osource "C:/zephyr-workspace/zephyr/arch/hexagon/Kconfig"
osource "C:/zephyr-workspace/zephyr/arch/rx/Kconfig"
osource "C:/zephyr-workspace/zephyr/arch/x86/Kconfig"
osource "C:/zephyr-workspace/zephyr/arch/xtensa/Kconfig"
osource "C:/zephyr-workspace/zephyr/arch/sparc/Kconfig"
osource "C:/zephyr-workspace/zephyr/arch/riscv/Kconfig"
osource "C:/zephyr-workspace/zephyr/arch/posix/Kconfig"
osource "C:/zephyr-workspace/zephyr/arch/openrisc/Kconfig"
osource "C:/zephyr-workspace/zephyr/arch/mips/Kconfig"
osource "C:/zephyr-workspace/zephyr/arch/arm64/Kconfig"
osource "C:/zephyr-workspace/zephyr/arch/arm/Kconfig"
osource "C:/zephyr-workspace/zephyr/arch/arc/Kconfig"
```

## app/build/Kconfig/boards/Kconfig.defconfig
```kconfig
# Load Zephyr board defconfig descriptions.
osource "C:/zephyr-workspace/zephyr/boards/atmel/sam0/samr21_xpro/Kconfig.defconfig"
```

## app/build/Kconfig/boards/Kconfig.samr21_xpro
```kconfig
# Load board Kconfig descriptions.
osource "C:/zephyr-workspace/zephyr/boards/atmel/sam0/samr21_xpro/Kconfig.samr21_xpro"
```

## app/build/Kconfig/boards/Kconfig.sysbuild
```kconfig
# Load Sysbuild board Kconfig descriptions.
osource "C:/zephyr-workspace/zephyr/boards/atmel/sam0/samr21_xpro/Kconfig.sysbuild"
```

## app/build/Kconfig/soc/Kconfig
```kconfig
# Load Zephyr SoC Kconfig descriptions.
osource "C:/zephyr-workspace/zephyr/soc/xlnx/zynqmp/Kconfig"
osource "C:/zephyr-workspace/zephyr/soc/xlnx/zynq7000/Kconfig"
osource "C:/zephyr-workspace/zephyr/soc/xlnx/versalnet/Kconfig"
osource "C:/zephyr-workspace/zephyr/soc/xlnx/versal2/Kconfig"
osource "C:/zephyr-workspace/zephyr/soc/xlnx/versal/Kconfig"
osource "C:/zephyr-workspace/zephyr/soc/xen/Kconfig"
osource "C:/zephyr-workspace/zephyr/soc/wch/ch32v/Kconfig"
osource "C:/zephyr-workspace/zephyr/soc/ti/tiva_c/Kconfig"
osource "C:/zephyr-workspace/zephyr/soc/ti/simplelink/Kconfig"
osource "C:/zephyr-workspace/zephyr/soc/ti/mspm/Kconfig"
osource "C:/zephyr-workspace/zephyr/soc/ti/lm3s6965/Kconfig"
osource "C:/zephyr-workspace/zephyr/soc/ti/k3/Kconfig"
osource "C:/zephyr-workspace/zephyr/soc/ti/am13/Kconfig"
osource "C:/zephyr-workspace/zephyr/soc/telink/tlsr/Kconfig"
osource "C:/zephyr-workspace/zephyr/soc/syna/sr100/Kconfig"
osource "C:/zephyr-workspace/zephyr/soc/starfive/jh71xx/Kconfig"
osource "C:/zephyr-workspace/zephyr/soc/st/stm32/Kconfig"
osource "C:/zephyr-workspace/zephyr/soc/snps/qemu_arc/Kconfig"
osource "C:/zephyr-workspace/zephyr/soc/snps/nsim/arc_v/Kconfig"
osource "C:/zephyr-workspace/zephyr/soc/snps/nsim/arc_classic/Kconfig"
osource "C:/zephyr-workspace/zephyr/soc/snps/hsdk4xd/Kconfig"
osource "C:/zephyr-workspace/zephyr/soc/snps/hsdk/Kconfig"
osource "C:/zephyr-workspace/zephyr/soc/snps/emsk/Kconfig"
osource "C:/zephyr-workspace/zephyr/soc/snps/emsdp/Kconfig"
osource "C:/zephyr-workspace/zephyr/soc/snps/arc_iot/Kconfig"
osource "C:/zephyr-workspace/zephyr/soc/silabs/Kconfig"
osource "C:/zephyr-workspace/zephyr/soc/sifli/sf32/Kconfig"
osource "C:/zephyr-workspace/zephyr/soc/sifive/sifive_freedom/Kconfig"
osource "C:/zephyr-workspace/zephyr/soc/shakti/Kconfig"
osource "C:/zephyr-workspace/zephyr/soc/sensry/Kconfig"
osource "C:/zephyr-workspace/zephyr/soc/rockchip/Kconfig"
osource "C:/zephyr-workspace/zephyr/soc/renode/riscv_virtual/Kconfig"
osource "C:/zephyr-workspace/zephyr/soc/renode/cortex_r8_virtual/Kconfig"
osource "C:/zephyr-workspace/zephyr/soc/renesas/smartbond/Kconfig"
osource "C:/zephyr-workspace/zephyr/soc/renesas/rz/Kconfig"
osource "C:/zephyr-workspace/zephyr/soc/renesas/rx/Kconfig"
osource "C:/zephyr-workspace/zephyr/soc/renesas/rcar/Kconfig"
osource "C:/zephyr-workspace/zephyr/soc/renesas/ra/Kconfig"
osource "C:/zephyr-workspace/zephyr/soc/realtek/fingerprint/Kconfig"
osource "C:/zephyr-workspace/zephyr/soc/realtek/ec/Kconfig"
osource "C:/zephyr-workspace/zephyr/soc/realtek/bee/Kconfig"
osource "C:/zephyr-workspace/zephyr/soc/realtek/ameba/Kconfig"
osource "C:/zephyr-workspace/zephyr/soc/raspberrypi/rpi_pico/Kconfig"
osource "C:/zephyr-workspace/zephyr/soc/quicklogic/eos_s3/Kconfig"
osource "C:/zephyr-workspace/zephyr/soc/qemu/virt_riscv/Kconfig"
osource "C:/zephyr-workspace/zephyr/soc/qemu/tricore/Kconfig"
osource "C:/zephyr-workspace/zephyr/soc/qemu/or1k/Kconfig"
osource "C:/zephyr-workspace/zephyr/soc/qemu/malta/Kconfig"
osource "C:/zephyr-workspace/zephyr/soc/qemu/hexagon/Kconfig"
osource "C:/zephyr-workspace/zephyr/soc/openisa/rv32m1/Kconfig"
osource "C:/zephyr-workspace/zephyr/soc/openhwgroup/cva6/Kconfig"
osource "C:/zephyr-workspace/zephyr/soc/oct/osd32mp15x/Kconfig"
osource "C:/zephyr-workspace/zephyr/soc/nxp/s32/Kconfig"
osource "C:/zephyr-workspace/zephyr/soc/nxp/rw/Kconfig"
osource "C:/zephyr-workspace/zephyr/soc/nxp/mcx/Kconfig"
osource "C:/zephyr-workspace/zephyr/soc/nxp/lpc/Kconfig"
osource "C:/zephyr-workspace/zephyr/soc/nxp/layerscape/Kconfig"
osource "C:/zephyr-workspace/zephyr/soc/nxp/kinetis/Kconfig"
osource "C:/zephyr-workspace/zephyr/soc/nxp/imxrt/Kconfig"
osource "C:/zephyr-workspace/zephyr/soc/nxp/imx/Kconfig"
osource "C:/zephyr-workspace/zephyr/soc/nuvoton/numicro/Kconfig"
osource "C:/zephyr-workspace/zephyr/soc/nuvoton/numaker/Kconfig"
osource "C:/zephyr-workspace/zephyr/soc/nuvoton/npcx/Kconfig"
osource "C:/zephyr-workspace/zephyr/soc/nuvoton/npcm/Kconfig"
osource "C:/zephyr-workspace/zephyr/soc/nordic/Kconfig"
osource "C:/zephyr-workspace/zephyr/soc/neorv32/Kconfig"
osource "C:/zephyr-workspace/zephyr/soc/native/inf_clock/Kconfig"
osource "C:/zephyr-workspace/zephyr/soc/microchip/smartfusion2/Kconfig"
osource "C:/zephyr-workspace/zephyr/soc/microchip/sam/sama7/Kconfig"
osource "C:/zephyr-workspace/zephyr/soc/microchip/sam/sama5/Kconfig"
osource "C:/zephyr-workspace/zephyr/soc/microchip/sam/sam_d5x_e5x/Kconfig"
osource "C:/zephyr-workspace/zephyr/soc/microchip/pic64/Kconfig"
osource "C:/zephyr-workspace/zephyr/soc/microchip/pic32c/pic32cz_ca/Kconfig"
osource "C:/zephyr-workspace/zephyr/soc/microchip/pic32c/pic32cx_sg/Kconfig"
osource "C:/zephyr-workspace/zephyr/soc/microchip/pic32c/pic32cm_sg_gc/Kconfig"
osource "C:/zephyr-workspace/zephyr/soc/microchip/pic32c/pic32cm_pl/Kconfig"
osource "C:/zephyr-workspace/zephyr/soc/microchip/pic32c/pic32cm_jh/Kconfig"
osource "C:/zephyr-workspace/zephyr/soc/microchip/pic32c/pic32ck_sg_gc/Kconfig"
osource "C:/zephyr-workspace/zephyr/soc/microchip/miv/Kconfig"
osource "C:/zephyr-workspace/zephyr/soc/microchip/mec/Kconfig"
osource "C:/zephyr-workspace/zephyr/soc/mediatek/mt8xxx/Kconfig"
osource "C:/zephyr-workspace/zephyr/soc/lowrisc/opentitan/Kconfig"
osource "C:/zephyr-workspace/zephyr/soc/litex/Kconfig"
osource "C:/zephyr-workspace/zephyr/soc/ite/ec/Kconfig"
osource "C:/zephyr-workspace/zephyr/soc/intel/wildcat_lake/Kconfig"
osource "C:/zephyr-workspace/zephyr/soc/intel/raptor_lake/Kconfig"
osource "C:/zephyr-workspace/zephyr/soc/intel/panther_lake/Kconfig"
osource "C:/zephyr-workspace/zephyr/soc/intel/nova_lake/Kconfig"
osource "C:/zephyr-workspace/zephyr/soc/intel/lakemont/Kconfig"
osource "C:/zephyr-workspace/zephyr/soc/intel/intel_socfpga_std/Kconfig"
osource "C:/zephyr-workspace/zephyr/soc/intel/intel_socfpga/Kconfig"
osource "C:/zephyr-workspace/zephyr/soc/intel/intel_niosv/Kconfig"
osource "C:/zephyr-workspace/zephyr/soc/intel/intel_ish/Kconfig"
osource "C:/zephyr-workspace/zephyr/soc/intel/intel_adsp/Kconfig"
osource "C:/zephyr-workspace/zephyr/soc/intel/elkhart_lake/Kconfig"
osource "C:/zephyr-workspace/zephyr/soc/intel/atom/Kconfig"
osource "C:/zephyr-workspace/zephyr/soc/intel/apollo_lake/Kconfig"
osource "C:/zephyr-workspace/zephyr/soc/intel/alder_lake/Kconfig"
osource "C:/zephyr-workspace/zephyr/soc/infineon/psoc4/Kconfig"
osource "C:/zephyr-workspace/zephyr/soc/infineon/edge/Kconfig"
osource "C:/zephyr-workspace/zephyr/soc/infineon/cat3/Kconfig"
osource "C:/zephyr-workspace/zephyr/soc/infineon/cat1c/Kconfig"
osource "C:/zephyr-workspace/zephyr/soc/infineon/cat1b/Kconfig"
osource "C:/zephyr-workspace/zephyr/soc/infineon/cat1a/Kconfig"
osource "C:/zephyr-workspace/zephyr/soc/gd/gd32/Kconfig"
osource "C:/zephyr-workspace/zephyr/soc/gaisler/leon3/Kconfig"
osource "C:/zephyr-workspace/zephyr/soc/gaisler/gr716a/Kconfig"
osource "C:/zephyr-workspace/zephyr/soc/focaltech/Kconfig"
osource "C:/zephyr-workspace/zephyr/soc/espressif/Kconfig"
osource "C:/zephyr-workspace/zephyr/soc/ene/kb1200/Kconfig"
osource "C:/zephyr-workspace/zephyr/soc/ene/kb106x/Kconfig"
osource "C:/zephyr-workspace/zephyr/soc/elan/em32f967/Kconfig"
osource "C:/zephyr-workspace/zephyr/soc/egis/Kconfig"
osource "C:/zephyr-workspace/zephyr/soc/efinix/sapphire/Kconfig"
osource "C:/zephyr-workspace/zephyr/soc/cdns/xtensa_sample_controller/Kconfig"
osource "C:/zephyr-workspace/zephyr/soc/cdns/swerv/Kconfig"
osource "C:/zephyr-workspace/zephyr/soc/cdns/sample_controller32/Kconfig"
osource "C:/zephyr-workspace/zephyr/soc/cdns/dc233c/Kconfig"
osource "C:/zephyr-workspace/zephyr/soc/cdac/Kconfig"
osource "C:/zephyr-workspace/zephyr/soc/brcm/bcmvk/Kconfig"
osource "C:/zephyr-workspace/zephyr/soc/brcm/bcm2712/Kconfig"
osource "C:/zephyr-workspace/zephyr/soc/brcm/bcm2711/Kconfig"
osource "C:/zephyr-workspace/zephyr/soc/brcm/bcm2710/Kconfig"
osource "C:/zephyr-workspace/zephyr/soc/blackberry/qnxhv_vm/Kconfig"
osource "C:/zephyr-workspace/zephyr/soc/bflb/Kconfig"
osource "C:/zephyr-workspace/zephyr/soc/atmel/sam0/Kconfig"
osource "C:/zephyr-workspace/zephyr/soc/atmel/sam/Kconfig"
osource "C:/zephyr-workspace/zephyr/soc/aspeed/Kconfig"
osource "C:/zephyr-workspace/zephyr/soc/arm/Kconfig"
osource "C:/zephyr-workspace/zephyr/soc/antmicro/myra/Kconfig"
osource "C:/zephyr-workspace/zephyr/soc/andestech/Kconfig"
osource "C:/zephyr-workspace/zephyr/soc/amd/acp_7_x/Kconfig"
osource "C:/zephyr-workspace/zephyr/soc/amd/acp_7_0/Kconfig"
osource "C:/zephyr-workspace/zephyr/soc/amd/acp_6_0/Kconfig"
osource "C:/zephyr-workspace/zephyr/soc/ambiq/Kconfig"
osource "C:/zephyr-workspace/zephyr/soc/allwinner/sun8i_h3/Kconfig"
osource "C:/zephyr-workspace/zephyr/soc/allwinner/sun50i_h618/Kconfig"
osource "C:/zephyr-workspace/zephyr/soc/alif/ensemble/Kconfig"
osource "C:/zephyr-workspace/zephyr/soc/alif/balletto/Kconfig"
osource "C:/zephyr-workspace/zephyr/soc/aesc/Kconfig"
osource "C:/zephyr-workspace/zephyr/soc/adi/max32/Kconfig"
```
